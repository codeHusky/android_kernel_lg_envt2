## arch/arm/mach-msm/lge/Kconfig
```kconfig
config MACH_LGE
	bool

menu "LGE Device-Specific Changes"

config LGE_MACH_ENVT2_CHECK_HW_REV
	depends on ARCH_QSD8X50
	depends on MSM_SOC_REV_NONE
	depends on MSM_STACKED_MEMORY
	default n
	bool "enV Touch2 Check HW Rev"
	help
           Support for the enV Touch2 board.

# LGE_CHANGE_S [eklee.lee@lge.com]
config LGE_HEADSET
	depends on ARCH_QSD8X50
	default y
	bool "enV Touch2 Headset"
	help
           Support for the enV Touch2 board.
# LGE_CHANGE_S [eklee.lee@lge.com] 

config LGE_CAMERA_FLASH
	depends on ARCH_QSD8X50
	default n
	bool "enV Touch2 Camera Flash"
	help
           Support for the enV Touch2 board.


config LGE_CAMERA_AUTO_FOCUS
	depends on ARCH_QSD8X50
	default n
	bool "enV Touch2 Camera Auto Focus"
	help
           Support for the enV Touch2 board.

config LGE_CAMERA_DEBUG
	depends on ARCH_QSD8X50
	default n
	bool "enV Touch2 Camera Debug"
	help
           Support for the enV Touch2 board.

config LGE_CAMERA_QCT_SBA
	depends on ARCH_QSD8X50
	default n
	bool "enV Touch2 Camera QCT SBA"
	help
           Support for the enV Touch2 board.

config LGE_CAMERA_SOF_OFF 
	depends on ARCH_QSD8X50
	default n
	bool "enV Touch2 Camera QCT SOF Disable"
	help
           Support for the enV Touch2 board.

config LGE_CAMERA_QCT_FREEZE_FIX 
	depends on ARCH_QSD8X50
	default n
	bool "enV Touch2 Camera QCT Freeze Fix"
	help
           Support for the enV Touch2 board.

config LGE_INPUT_SENSOR
	depends on ARCH_QSD8X50
	default n
	bool "enV Touch2 input sensor"
	help
           Support for the enV Touch2 board.

config LGE_SENSOR_GP2AP
	depends on ARCH_QSD8X50
	default n
	bool "enV Touch2 sensor gp2ap"
	help
           Support for the enV Touch2 board.

config LGE_SENSOR_KR3DH
	depends on ARCH_QSD8X50
	default n
	bool "enV Touch2 sensor kr3dh"
	help
           Support for the enV Touch2 board.

config LGE_SENSOR_AK8973
	depends on ARCH_QSD8X50
	default n
	bool "enV Touch2 sensor ak8973"
	help
           Support for the enV Touch2 board.
           
# LGE_CHANGE_S [eklee.lee@lge.com] 2010-03-19, LG_FW_AUDIO_SUBSYSTEM
config LGE_AUDIO_AMP_LM49250
	bool "Audio AMP LM49250"
	depends on LGE_MACH_ENVT2
	default y
	help
	  LM49250 audio Amplifier
# LGE_CHANGE_S [eklee.lee@lge.com] 2010-03-19, LG_FW_AUDIO_SUBSYSTEM

config LGE_USE_OEM_RAPI
	bool "Support LGE OEM RAPI"
	default y
	depends on LGE_MACH_ENVT2
	help
	  LGE remote api functions

config LGE_CAMERA_CONFIG
	bool "Support LGE CAMERA HW configuration"
	default n
	depends on LGE_MACH_ENVT2
	help
	  LGE CAMERA HW configuration

config LGE_CAMERA_DEBUG
	bool "Support LGE CAMERA debug"
	default n
	depends on LGE_MACH_ENVT2
	help
	  LGE CAMERA debug

config LGE_CAMERA_USE_GPIO_I2C
	bool "Support LGE CAMERA I2C"
	default n
	help
	  LGE CAMERA I2C

config LGE_CAM_LOCKUP_TEMP
	bool "Support LGE CAMERA LOCKUP TEMP"
	default n
	depends on LGE_MACH_ENVT2
	help
	  LGE CAMERA LOCKUP TEMP

config LGE_AUDIO_TUNNING
	bool "Support LGE AUDIO TUNNING"
	default n
	depends on LGE_MACH_ENVT2
	help
	  LGE AUDIO TUNNING

config LGE_AUDIO_CAD_ADD
	bool "Support LGE AUDIO CAD"
	default n
	depends on LGE_MACH_ENVT2
	help
	  LGE AUDIO CAD

config LGE_AUDIO_SUBSYSTEM
	bool "Support LGE AUDIO LM49250 AMP"
	default n
	depends on LGE_MACH_ENVT2
	help
	  LGE AUDIO LM49250 AMP

config LGE_AUDIO_PWM_VIBRATOR
	bool "Support LGE AUDIO PWM VIBRATOR"
	default n
	depends on LGE_MACH_ENVT2
	help
	  LGE AUDIO PWM VIBRATOR IN APPLICATION

config LGE_AUDIO_HEADSET
	bool "Support LGE AUDIO EARJACK DETECTION"
	default n
	depends on LGE_MACH_ENVT2
	help
	  LGE AUDIO EARJACK DETECTION

config LGE_AUDIO_HEADSET_PROTECT
	bool "Support LGE AUDIO HEADSET PROTECTION"
	default n
	depends on LGE_AUDIO_HEADSET
	help
	  LGE AUDIO HEADSET PROTECTION
	  
config LGE_AUDIO_MVS_PKT_LOOPBACK
	bool "Support CONFIG_LGE_AUDIO_MVS_PKT_LOOPBACK"
	default n
	depends on LGE_MACH_ENVT2
	help
	  CONFIG_LGE_AUDIO_MVS_PKT_LOOPBACK

config LGE_ERS
	tristate "Support LGE ERS system"
	default n
	depends on LGE_MACH_ENVT2
	depends on LGE_RAM_CONSOLE
	help
	  LGE error reporting system

config LGE_HANDLE_MODEM_CRASH
	tristate "Support LGE Modem Crash Handler"
	default n
	depends on LGE_MACH_ENVT2
	depends on LGE_RAM_CONSOLE
	help
	  LGE modem crash handler

config LGE_RAM_CONSOLE
	bool "Support kmsg save in the ram console area"
	default n
	depends on LGE_MACH_ENVT2
	help
	  Support kmsg save

config LGE_RAM_CONSOLE_CLEAN
	bool "Clean ram console"
	default n
	help
	  Clean ram console when powered off normally

config LGE_PROC_COMM
	bool "LGE added proc comm"
	depends on LGE_MACH_ENVT2
	default n
	help
	  LGE added proc_comm

menu "LGE specific patches"
	depends on LGE_MACH_ENVT2



# LGE_CHANGE [dojip.kim@lge.com] 2010-08-17
config LGE_RTC_INTF_ALARM_SYNC
	bool "LGE alarm sync (fix the elapsed time)"
	default n
	help
	  This patch is alarm sync to fix the wrong elapsed time 

# LGE_CHANGE [dojip.kim@lge.com] 2010-09-05, avoid the rooting via hotplug
config LGE_BLOCK_HOTPLUG
	bool "LGE block the hotplug"
	default n
	help
	  Android doesn't need a hotplug. So, block the hotplug to avoid the rooting

endmenu

endmenu
```

## drivers/char/diag/Kconfig
```kconfig
menu "Diag Support"

config DIAG_CHAR
	tristate "char driver interface and diag forwarding to/from ARM9"
	default m
	depends on USB_ANDROID_DIAG || USB_FUNCTION_DIAG
	depends on ARCH_MSM
	help
	 Char driver interface for diag user space and diag-forwarding to modem ARM and back.

config LGE_DIAG_KERNEL_SERVICE
	bool "Support LGE diag kernel service"
	default y
	depends on LGE_MACH_ENVT2
	help
	  LGE diag kernel service enable

config LGE_DIAG_TESTMODE
	bool "Support LGE diag TESTMODE"
	default n
	depends on LGE_DIAG_KERNEL_SERVICE
	help
	  LGE diag TESTMODE enable

config LGE_CAMERA_TESTMODE
	bool "Support LGE CAMERA TESTMODE"
	default n
	depends on LGE_DIAG_TESTMODE
	help
	  LGE CAMERA TESTMODE

config LGE_AUDIO_TESTMODE
	bool "Support LGE AUDIO TESTMODE"
	default n
	depends on LGE_DIAG_TESTMODE
	help
	  LGE AUDIO TESTMODE

config LGE_AUDIO_TUNE_TOOL
	bool "Support LGE AUDIO tunning"
	default n
	depends on LGE_DIAG_KERNEL_SERVICE
	help
	  LGE AUDIO tunning tool

config LGE_APPS_FACTORY_RESET
	bool "Support LGE factory reset"
	default n
	depends on LGE_DIAG_KERNEL_SERVICE
	help
	  LGE Factory reset for applications

config LGE_MTD_DIRECT_ACCESS
	bool "Support LGE factory reset MTD access"
	default n
	depends on LGE_APPS_FACTORY_RESET
	help
	  LGE MTD access for Factory reset

config LGE_DIAG_WMC
	bool "Support LGE diag WMC"
	default n
	depends on LGE_DIAG_KERNEL_SERVICE
	help
	  LGE diag WMC enable

config LGE_ATS_ETA_MTC
	bool "Support LGE ETA and MTC service"
	default n
	depends on LGE_DIAG_KERNEL_SERVICE
	help
	  LGE ETA and MTC

config LGE_ATS_ETA_MTC_KEY_LOGGING
	bool "Support LGE ETA and MTC key, touch logging service"
	default n
	depends on LGE_ATS_ETA_MTC
	help
	  send key and touch logging data to a tool

config LGE_ATS_ETA_MTC_KEY_LOGGING_JIFFIES
	bool "Support LGE ETA and MTC key, touch logging timer"
	default n
	depends on LGE_ATS_ETA_MTC_KEY_LOGGING
	help
	  send key and touch logging timer data to a tool

config LGE_DIAG_UTS
	bool "Support LGE UTS and UDM service"
	default n
	depends on LGE_DIAG_KERNEL_SERVICE
	help
	  LGE UTS and UDM

config LGE_DIAG_UTS_KEYPRESS
	bool "Support LGE UTS and UDM keypress test"
	default n
	depends on LGE_DIAG_UTS
	help
	  LGE UTS and UDM keypress test

config LGE_DIAG_UTS_SCREEN_SHOT
	bool "Support LGE UTS and UDM screen capture"
	default n
	depends on LGE_DIAG_UTS
	help
	  LGE UTS and UDM screen capture

endmenu
```

## drivers/input/sensor/Kconfig
```kconfig
#
# Sensor driver configuration
#
menuconfig INPUT_SENSOR
	bool "Sensors"
	help
	  Say Y here, and a list of supported touchscreens will be displayed.
	  This option doesn't affect the kernel.

	  If unsure, say Y.

if INPUT_SENSOR

config LGE_INPUT_SENSOR
	bool "General Sensor definition"
	default n
	help
	  General Sensor definition

config SENSOR_GP2AP
	tristate "GP2AP based proximity sensor"
	default y #2010.05.07 woochang.chun
	help
	  Say Y here if you have a sensor interface using the
	  GP2AP controller, and your board-specific
	  setup code includes i2c devices.

	  If unsure, say N (but it's safe to say "Y").

	  To compile this driver as a module, choose M here: the
	  module will be called ads7846.


config SENSOR_KR3DH
	tristate "KR3DH based accelerometer sensor"
	default y #2010.05.07 woochang.chun
	help
	  Say Y here if you have a sensor interface using the
	  KR3DH controller, and your board-specific
	  setup code includes i2c devices.

	  If unsure, say N (but it's safe to say "Y").

	  To compile this driver as a module, choose M here: the
	  module will be called ads7846.

  
config SENSOR_AK8973
	tristate "AK8973 based ecompass sensor"
	default y #2010.05.07 woochang.chun
	help
	  Say Y here if you have a sensor interface using the
	  AK8973 controller, and your board-specific
	  setup code includes i2c devices.

	  If unsure, say N (but it's safe to say "Y").

	  To compile this driver as a module, choose M here: the
	  module will be called ads7846.
      
endif
```
